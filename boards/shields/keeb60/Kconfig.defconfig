## boards/shields/keeb60/Kconfig.defconfig
```kconfig
if KEEB_60

# Name must be less than 16 characters long!
config KEEB_60
    default "keeb60"

endif
```

## boards/shields/keeb60/Kconfig.shield
```kconfig
# No whitespace after the comma or in your keyboard name!
config KEEB_60
    def_bool $(shields_list_contains,my_keyboard)
```
